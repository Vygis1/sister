`timescale 1ns / 1ps
//////////////////////////////////////////////////////////////////////////////////
// tb_z80 - run the Z80 test programs and let them say whether they passed.
//
// The three programs in sim/roms/z80 are CP/M .COM files: they load at $0100
// and talk to the operating system through a call to $0005. There is no CP/M
// here, so this is the smallest shim that satisfies them:
//
//   $0000   HALT   -- a finished program jumps here to exit
//   $0005   RET    -- the CPU returns immediately; the testbench watches for
//                     the opcode fetch at $0005 and does the work itself
//
// BDOS function 2 prints the character in E; function 9 prints the
// $-terminated string at DE. That is the entire operating system these tests
// need, and it is what turns "does my CPU work" into a question the program
// answers out loud instead of one answered by staring at a waveform.
//
// Run order matters. prelim.com is small and fails early and loudly; zexdoc
// checks every documented instruction by CRC; zexall checks the undocumented
// flag bits too. Passing zexdoc while failing zexall means the flags are right
// where anyone is supposed to look and wrong where they are not.
//////////////////////////////////////////////////////////////////////////////////

module tb_z80;

	reg clk = 0, rst = 1;
	always #10 clk = ~clk;

	wire [15:0] addr;
	wire [7:0]  dout;
	reg  [7:0]  din;
	wire        we, io, m1;
	wire [15:0] dbg_pc, dbg_sp, dbg_af, dbg_bc, dbg_de, dbg_hl;

	z80 dut (
		.clk(clk), .rst(rst), .ce(1'b1),
		.addr(addr), .din(din), .dout(dout), .we(we), .io(io), .m1(m1),
		.int_n(1'b1), .nmi_n(1'b1),
		.dbg_pc(dbg_pc), .dbg_sp(dbg_sp), .dbg_af(dbg_af),
		.dbg_bc(dbg_bc), .dbg_de(dbg_de), .dbg_hl(dbg_hl), .dbg_m1()
	);

	// 64 kB, synchronous read: an address presented now returns data next
	// cycle, which is what the core is written against.
	reg [7:0] mem [0:65535];
	always @(posedge clk) begin
		if (we && !io) mem[addr] <= dout;
		din <= mem[addr];
	end

	// --- the operating system, such as it is -------------------------------------
	// Not a testbench trap: the same few instructions that get dropped into low
	// memory on the board, so what runs here is what runs there. Output leaves
	// through an I/O port, which is all the hardware has to capture.
	integer chars = 0, i;
	reg finished = 0;
	reg [8*64-1:0] tail;

	always @(posedge clk) begin
		if (!rst && we && io) begin
			if (dout >= 8'h20 && dout < 8'h7F) $write("%c", dout);
			else if (dout == 8'h0A) $write("\n");
			else if (dout != 8'h0D) $write(".");
			$fflush;
			chars <= chars + 1;
			tail  <= {tail[8*63-1:0], dout};
		end
		// A finished CP/M program jumps to $0000, where the shim puts a HALT.
		if (!rst && dut.halted && chars > 0) finished <= 1'b1;
	end

	// --- which program ------------------------------------------------------------
	reg [8*64-1:0] romfile;
	integer fh, n, b;

	initial begin
		for (i = 0; i < 65536; i = i + 1) mem[i] = 8'h00;

		if (!$value$plusargs("rom=%s", romfile)) romfile = "prelim.com";

		// $readmemh cannot read a binary, so the file is turned into hex next to
		// it by tools/z80rom.py and loaded from there.
		$readmemh("../../sim/roms/z80/test.hex", mem, 16'h0100);

		// The same bytes the board runs, generated by tools/z80shim.py.
		$readmemh("../../sim/roms/z80/shim.hex", mem, 16'h0000);

		$display("tb_z80");
		$display("  ----------------------------------------------------------");

		repeat (4) @(posedge clk);
		rst = 0;
		// No forcing of PC or SP: the bootstrap does both, exactly as it will
		// have to on the board.
	end

	// --- watchdogs ------------------------------------------------------------------
	integer cycles = 0;
	reg [15:0] last_pc = 16'hFFFF;
	integer    stuck = 0;

	always @(posedge clk) begin
		if (!rst) begin
			cycles <= cycles + 1;
			if (m1) begin
				if (dbg_pc == last_pc) stuck <= stuck + 1;
				else begin stuck <= 0; last_pc <= dbg_pc; end
			end
		end
	end

	initial begin
		wait (finished);
		repeat (100) @(posedge clk);
		$display("");
		$display("  ----------------------------------------------------------");
		$display("  program exited after %0d cycles, %0d characters printed", cycles, chars);
		// The tests print the word "ERROR" on any mismatch, so the transcript
		// itself is the verdict.
		$display("tb_z80: done");
		$finish;
	end

	initial begin
		forever begin
			repeat (50_000_000) @(posedge clk);
			if (!finished)
				$display("\n  [%0d cycles, PC=0x%04X, SP=0x%04X, AF=0x%04X]",
				         cycles, dbg_pc, dbg_sp, dbg_af);
		end
	end

	initial begin
		while (cycles < 2_000_000_000 && !finished) @(posedge clk);
		if (!finished) begin
		$display("");
		$display("tb_z80: stopped at %0d cycles, PC=0x%04X, %0d characters in", cycles, dbg_pc, chars);
		$finish;
		end
	end

endmodule
